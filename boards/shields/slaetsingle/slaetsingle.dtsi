#include <dt-bindings/zmk/matrix_transform.h>
#include "slaetsingle_layouts.dtsi"


/ {
        chosen {
        zmk,kscan=&kscan_direct;
        zmk,matrix_transform=&direct_matrix_transform;
        };

    direct_matrix_transform: direct_matrix_transform {
        compatible = "zmk,matrix-transform";
        rows = <1>;
        columns = <4>;

        map = <
        RC(0,0) RC(0,1) RC(0,2) RC(0,3)
        >;
    };
    kscan_direct: kscan_direct {
        compatible = "zmk,kscan-gpio-direct";
        wakeup-source;

    input-gpios
        = <&pro_micro 9 (GPIO_ACTIVE_LOW | GPIO_PULL_UP)>
        , <&pro_micro 10  (GPIO_ACTIVE_LOW | GPIO_PULL_UP)>
        , <&pro_micro 11 (GPIO_ACTIVE_LOW | GPIO_PULL_UP)>
        , <&pro_micro 13 (GPIO_ACTIVE_LOW | GPIO_PULL_UP)>
        ;

    };
};