#include "slaetrp2040.dtsi"

&kscan0 {
   compatible = "zmk,kscan-gpio-matrix";
    wakeup-source;
    diode-direction = "col2row";
    
        col-gpios
            = <&gpio0 0 GPIO_ACTIVE_HIGH>
            ;

        row-gpios
            = <&gpio0 1  (GPIO_ACTIVE_HIGH | GPIO_PULL_DOWN)>
            ;
};  
