
#include <behaviors.dtsi>
#include <dt-bindings/zmk/keys.h>
#include <dt-bindings/zmk/bt.h>
#include <dt-bindings/zmk/outputs.h>

#define DEFAULT     0

/{
        keymap {   
                compatible = "zmk,keymap";
                default_layer {

        bindings = <
            &kp SPACE
        >;
                };
        };
};

/* You will never find what you seek... stop looking */