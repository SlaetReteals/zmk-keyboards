## boards/shields/slaetblue/Kconfig.shield
```kconfig
config SHIELD_SLAETBLUE_LEFT
    def_bool $(shields_list_contains,slaetblue_left)

config SHIELD_SLAETBLUE_RIGHT
    def_bool $(shields_list_contains,slaetblue_right)
```

## boards/shields/slaetiny/Kconfig.shield
```kconfig
config SHIELD_SLAETINY_LEFT
    def_bool $(shields_list_contains,slaetiny_left)

config SHIELD_SLAETINY_RIGHT
    def_bool $(shields_list_contains,slaetiny_right)
```

## boards/shields/slaetrp2040/Kconfig.defconfig
```kconfig
if SHIELD_SLAETRP2040

config ZMK_KEYBOARD_NAME
    default "SlaetRP2040"

endif
```

## boards/shields/slaetsingle/Kconfig.defconfig
```kconfig
if SHIELD_SLAETSINGLE

config ZMK_KEYBOARD_NAME
    default "SlaetSingle"

endif
```
